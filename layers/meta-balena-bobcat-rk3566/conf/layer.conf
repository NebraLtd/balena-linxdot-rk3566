## layers/meta-balena-bobcat-rk3566/conf/layer.conf
```bitbake
BBPATH .= ":${LAYERDIR}"

BBFILES += "${LAYERDIR}/recipes-*/*/*.bb \
            ${LAYERDIR}/recipes-*/*/*.bbappend"

BBFILE_COLLECTIONS += "balena-bobcat-rk3566"
BBFILE_PATTERN_balena-bobcat-rk3566 := "^${LAYERDIR}/"
BBFILE_PRIORITY_balena-bobcat-rk3566 = "1337"

LAYERSERIES_COMPAT_balena-bobcat-rk3566= "kirkstone"

# we do not use Rockchip's u-boot
BBMASK += "meta-rockchip/recipes-bsp/u-boot"

# we use our custom kernel recipe
BBMASK += "meta-rockchip/recipes-kernel/linux"

IMAGE_INSTALL:append = " bluetooth-broadcom board-init wireless-regdb-static wifi-firmware"
```

## layers/meta-balena-bobcat-rk3566/conf/machine/bobcat-rk3566.conf
```bitbake
#@TYPE: Machine
#@NAME: Bobcat RK3566

SOC_FAMILY = "rk3566"

RK_ISP_VERSION := "1"

require conf/machine/include/soc-family.inc
require conf/machine/include/arm/arch-armv8a.inc

PREFERRED_PROVIDER_virtual/bootloader = "u-boot-rockchip"
PREFERRED_PROVIDER_virtual/kernel = "linux-rockchip"
PREFERRED_VERSION_linux-rockchip = "4.4%"

SERIAL_CONSOLES = "1500000;ttyFIQ0"
KERNEL_IMAGETYPE = "Image"
KBUILD_DEFCONFIG = "bobcat_rk3566_defconfig"
KERNEL_DEVICETREE = "rockchip/rk3566-bobcat.dtb"
BALENA_DISABLE_KERNEL_HEADERS = "1"

UBOOT_MACHINE = "rk3568_defconfig"
```

## layers/meta-balena-linxdot-rk3566/conf/layer.conf
```bitbake
BBPATH .= ":${LAYERDIR}"

BBFILES += "${LAYERDIR}/recipes-*/*/*.bb \
            ${LAYERDIR}/recipes-*/*/*.bbappend"

BBFILE_COLLECTIONS += "balena-linxdot-rk3566"
BBFILE_PATTERN_balena-linxdot-rk3566 := "^${LAYERDIR}/"
BBFILE_PRIORITY_balena-linxdot-rk3566 = "1337"

LAYERSERIES_COMPAT_balena-linxdot-rk3566= "kirkstone"

# we do not use Rockchip's u-boot
BBMASK += "meta-rockchip/recipes-bsp/u-boot"

# we use our custom kernel recipe
BBMASK += "meta-rockchip/recipes-kernel/linux"

PACKAGE_INSTALL:remove = " initramfs-module-recovery initramfs-module-migrate"
IMAGE_INSTALL:append = " bluetooth-broadcom board-init wireless-regdb-static wifi-firmware"
CONNECTIVITY_FIRMWARES:remove = "linux-firmware-bcm43143"
```

## layers/meta-balena-linxdot-rk3566/conf/machine/linxdot-rk3566.conf
```bitbake
#@TYPE: Machine
#@NAME: Linxdot RK3566

SOC_FAMILY = "rk3566"

RK_ISP_VERSION := "1"

require conf/machine/include/soc-family.inc
require conf/machine/include/arm/arch-armv8a.inc

PREFERRED_PROVIDER_virtual/bootloader = "u-boot-rockchip"
PREFERRED_PROVIDER_virtual/kernel = "linux-rockchip"
PREFERRED_VERSION_linux-rockchip = "5.15"

SERIAL_CONSOLES = "1500000;ttyFIQ0"
KERNEL_IMAGETYPE = "Image"
KBUILD_DEFCONFIG = "defconfig"
KERNEL_DEVICETREE = "rockchip/rk3566-linxdot.dtb"
BALENA_DISABLE_KERNEL_HEADERS = "1"

UBOOT_MACHINE = "rk3568_defconfig"
IMAGE_ROOTFS_EXTRA_SPACE = "262144"
IMAGE_ROOTFS_MAXSIZE = "1048576"
```
